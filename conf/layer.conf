## conf/layer.conf
```bitbake
# We have a conf and classes directory, add to BBPATH
BBPATH := "${BBPATH}:${LAYERDIR}"

# We have a packages directory, add to BBFILES
BBFILES := "${BBFILES} ${LAYERDIR}/recipes-*/*/*.bb \
	    ${LAYERDIR}/recipes-*/*/*.bbappend"

# Leaving as is until better understanding
BBFILE_COLLECTIONS += "elphel"
BBFILE_PATTERN_elphel := "^${LAYERDIR}/"
BBFILE_PRIORITY_elphel = "8"
```

## meta-microzed/conf/layer.conf
```bitbake
# We have a conf and classes directory, add to BBPATH
BBPATH := "${BBPATH}:${LAYERDIR}"

# We have a packages directory, add to BBFILES
BBFILES := "${BBFILES} ${LAYERDIR}/recipes-*/*/*.bb \
	    ${LAYERDIR}/recipes-*/*/*.bbappend"

#leaving as is until better understanding
BBFILE_COLLECTIONS += "microzed"
BBFILE_PATTERN_microzed := "^${LAYERDIR}/"
BBFILE_PRIORITY_microzed = "8"
```

## meta-microzed/conf/machine/microzed.conf
```bitbake
#@TYPE: Machine
#@NAME: microzed 
#@DESCRIPTION: Machine support for microzed.

# Versions corresponding to zedboard documentation
#PREFERRED_VERSION_linux-xlnx ?= "3.8%"
#PREFERRED_VERSION_ezynq ?= "v2013.01%"

require conf/machine/include/tune-zynq.inc

# Microzed machine definition known by Xilinx UBOOT (patched with EZYNQ)
UBOOT_MACHINE = "zynq_microzed_config"

#this parameter is not used (taken from zedboard example)
#SERIAL_CONSOLE = "115200 ttyPS0"
```
